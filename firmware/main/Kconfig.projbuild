## firmware/main/Kconfig.projbuild
```kconfig
menu "VSCP CAN4VSCP gw Configuration"

    choice WCANG_PROV_TRANSPORT
        bool "Provisioning Transport"
        default WCANG_PROV_TRANSPORT_SOFTAP if IDF_TARGET_ESP32S2
        default WCANG_PROV_TRANSPORT_BLE
        help
            Wi-Fi provisioning component offers both, SoftAP and BLE transports. Choose any one.

        config WCANG_PROV_TRANSPORT_BLE
            bool "BLE"
            select BT_ENABLED
            depends on !IDF_TARGET_ESP32S2
        config WCANG_PROV_TRANSPORT_SOFTAP
            bool "Soft AP"
    endchoice

    choice WCANG_PROV_SECURITY_VERSION
        bool "Protocomm security version"
        default WCANG_PROV_SECURITY_VERSION_1
        help
            Wi-Fi provisioning component offers 3 security versions.
            The example offers a choice between security version 1 and 2.

        config WCANG_PROV_SECURITY_VERSION_1
            bool "Security version 1"
            select ESP_PROTOCOMM_SUPPORT_SECURITY_VERSION_1

        config WCANG_PROV_SECURITY_VERSION_2
            bool "Security version 2"
            select ESP_PROTOCOMM_SUPPORT_SECURITY_VERSION_2
    endchoice

    choice WCANG_PROV_MODE
        bool "Security version 2 mode"
        depends on WCANG_PROV_SECURITY_VERSION_2
        default WCANG_PROV_SEC2_DEV_MODE

        config WCANG_PROV_SEC2_DEV_MODE
            bool "Security version 2 development mode"
            depends on WCANG_PROV_SECURITY_VERSION_2
            help
                This enables the development mode for
                security version 2.
                Please note that this mode is NOT recommended for production purpose.

        config WCANG_PROV_SEC2_PROD_MODE
            bool "Security version 2 production mode"
            depends on WCANG_PROV_SECURITY_VERSION_2
            help
                This enables the production mode for
                security version 2.
    endchoice

    config WCANG_PROV_TRANSPORT
        int
        default 1 if WCANG_PROV_TRANSPORT_BLE
        default 2 if WCANG_PROV_TRANSPORT_SOFTAP

    config WCANG_RESET_PROVISIONED
        bool
        default n
        prompt "Reset provisioned status of the device"
        help
            This erases the NVS to reset provisioned status of the device on every reboot.
            Provisioned status is determined by the Wi-Fi STA configuration, saved on the NVS.

    config WCANG_RESET_PROV_MGR_ON_FAILURE
        bool
        default y
        prompt "Reset provisioned credentials and state machine after session failure"
        help
            Enable reseting provisioned credentials and state machine after session failure.
            This will restart the provisioning service after retries are exhausted.

    config WCANG_PROV_MGR_MAX_RETRY_CNT
        int
        default 5
        prompt "Max retries before reseting provisioning state machine"
        depends on WCANG_RESET_PROV_MGR_ON_FAILURE
        help
            Set the Maximum retry to avoid reconnecting to an inexistent AP or if credentials
            are misconfigured. Provisioned credentials are erased and internal state machine
            is reset after this threshold is reached.

    config WCANG_PROV_SHOW_QR
        bool "Show provisioning QR code"
        default y
        help
            Show the QR code for provisioning.

    config WCANG_PROV_USING_BLUEDROID
        bool
        depends on (BT_BLUEDROID_ENABLED && (IDF_TARGET_ESP32C3 || IDF_TARGET_ESP32S3))
        select BT_BLE_42_FEATURES_SUPPORTED
        default y
        help
            This enables BLE 4.2 features for Bluedroid.
endmenu
```

## firmware/sdkconfig.defaults
```kconfig
# Override some defaults so BT stack is enabled and
CONFIG_BT_ENABLED=y
CONFIG_BT_NIMBLE_ENABLED=y

## For Bluedroid as binary is larger than default size
CONFIG_PARTITION_TABLE_CUSTOM=y
CONFIG_PARTITION_TABLE_CUSTOM_FILENAME="partitions.csv"
CONFIG_PARTITION_TABLE_FILENAME="partitions.csv"
CONFIG_ESPTOOLPY_FLASHSIZE_4MB=y
CONFIG_ESPTOOLPY_FLASHSIZE="4MB"

# Required by main/websrv.c and main/websocksrv.c
CONFIG_HTTPD_WS_SUPPORT=y
```
